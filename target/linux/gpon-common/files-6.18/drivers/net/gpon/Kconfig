## target/linux/realtek-elnath/files-6.18/drivers/net/ethernet/cortina/Kconfig
```kconfig
# SPDX-License-Identifier: GPL-2.0
# Cortina ethernet devices

config NET_VENDOR_CORTINA
	bool "Cortina Gemini devices"
	default y
	help
	  If you have a network (Ethernet) card belonging to this class, say Y
	  and read the Ethernet-HOWTO, available from
	  <https://www.tldp.org/docs.html#howto>.

if NET_VENDOR_CORTINA

config GEMINI_ETHERNET
	tristate "Gemini Gigabit Ethernet support"
	depends on OF
	depends on HAS_IOMEM
	select PHYLIB
	select CRC32
	select CRC32
	help
	  This driver supports StorLink SL351x (Gemini) dual Gigabit Ethernet.

config CORTINA_NI
	tristate "Cortina-Access RTL9607F NI (network engine) Ethernet"
	depends on OF
	depends on HAS_IOMEM
	select PHYLIB
	help
	  This driver supports the Cortina-Access NI packet engine found in
	  the Realtek RTL9607F "Elnath" GPON SoC, including its internal
	  MDIO bus and quad GbE PHYs.

config CORTINA_NI_DSA
	bool "Expose the four RJ45 jacks as DSA ports lan1..lan4"
	depends on CORTINA_NI
	depends on NET_DSA
	select NET_DSA_TAG_CORTINA
	help
	  Register the RTL9607F NI's four LAN jacks as Linux DSA user ports
	  (lan1..lan4) behind the "eth0" conduit, so they appear as four
	  separate ports (e.g. in LuCI) and can be bridged/VLANed with the
	  standard Linux bridge.  The per-jack selector is carried in DMA
	  metadata (RX HEADER_A.lspid / TX DESC1_DEST), tagged by the
	  net/dsa/tag_cortina soft shim.  When off, the NI presents a single
	  "eth0" netdev for all four jacks.

config CORTINA_NI_FLOWOFFLOAD
	bool "Cortina-Access NI L3FE nf_flow_table hardware flow offload"
	depends on CORTINA_NI
	help
	  Drive the NE L3FE "main hash" flow engine (64K-entry NAPT
	  accelerator, mtk_ppe class) as an nf_flow_table hardware offload
	  backend on the RTL9607F "Elnath": ndo_setup_tc(TC_SETUP_FT/BLOCK)
	  flow_block glue, the software-computed CRC32/CRC16 install path,
	  age-based go-live/teardown and the batch liveness sweep.  When
	  disabled (or when the engine fails bring-up) every offload request
	  is refused and traffic stays on the normal software path.

config CORTINA_NI_REG_GUARD
	bool "Bound-check indexed register writes (debug)"
	depends on CORTINA_NI
	help
	  Warn once, naming the array and the index, when an indexed register
	  write goes past the array's declared entry count.

	  The hardware accepts a write to the wrong address silently, and no
	  compiler or sanitizer can see it: these are MMIO writes through an
	  ioremapped window, so there is no allocation to bound-check.  This is
	  the runtime half of the register-map guard -- it catches an index that
	  only goes out of range while running, which a build-time check cannot.

	  Costs nothing when off.  Say N for a shipping image.

config CORTINA_GPON
	tristate "Cortina-Access RTL9607F GPON MAC"
	depends on OF
	depends on HAS_IOMEM
	select CRC32
	select GPON_CORE	# shared core: drivers/net/gpon/Kconfig
	help
	  This driver supports the Cortina-Access GPON MAC (CA8277C class)
	  found in the Realtek RTL9607F "Elnath" GPON ONU SoC: the PON-MAC
	  register block, PSDS SerDes optics, PLOAM servicing and the GEM
	  datapath.  Clean-room re-expression of the Cortina ca-network-engine.

config CORTINA_GPON_OMCI_BRIDGE
	bool "Userspace stock-OMCI daemon bridge"
	depends on CORTINA_GPON
	select NETFILTER
	default y
	help
	  Present the two kernel seams the stock Zyxel/EcoNet omci_app / mosapp
	  daemon expects -- a NETLINK OMCI plane (protos 1 and 2), an nf_sockopt
	  control plane (optname 5400) and /proc/omci/devMode -- so the unmodified
	  daemon can run in a chroot and build the real OLT-provisioned MIB, bridged
	  to the in-kernel GPON MAC datapath.

	  The daemon's OMCI socket co-registers on NETLINK proto 2 alongside
	  NETLINK_USERSOCK without any core-kernel change (the .input callback is
	  per-socket).  Diversion is off until armed at runtime with
	  cortina_gpon.omci_userspace=1, so building this in is harmless otherwise.

	  If unsure, say Y.

endif # NET_VENDOR_CORTINA
```
